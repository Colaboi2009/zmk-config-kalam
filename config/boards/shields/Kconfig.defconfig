## config/boards/shields/Kconfig.defconfig
```kconfig
if SHIELD_KALAM_LEFT

config ZMK_KEYBOARD_NAME
    default "Kalam"

config ZMK_SPLIT_ROLE_CENTRAL
    default y

endif

if SHIELD_KALAM_LEFT || SHIELD_KALAM_RIGHT

config ZMK_SPLIT
    default y

endif
```

## config/boards/shields/kalam/Kconfig.shield
```kconfig
config SHIELD_KALAM_LEFT
    def_bool $(shields_list_contains,kalam_left)

config SHIELD_KALAM_RIGHT
    def_bool $(shields_list_contains,kalam_right)
```
